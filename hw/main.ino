#include <Ed25519.h>
#include <SPI.h>
#include <Wire.h>
#include <Adafruit_GFX.h>
#include <Adafruit_SSD1306.h>

#define SCREEN_W 128
#define SCREEN_H 64

#define OLED_RESET -1

Adafruit_SSD1306 display(SCREEN_W, SCREEN_H, &Wire, OLED_RESET);

const int buttonPin_L = D0;
const int buttonPin_R = D1;

uint8_t privateKey[32];
uint8_t publicKey[32];
uint8_t sig[64];

int state = 0;
String transaction = "";

// 0 - user is new - he has to create a wallet
// 1 - user has created wallet - is on homescreen
// 2-  user wants' to sign a tx
// 3 - user has signed a tx

static const uint8_t image_data_array[1024] = {0xff, 0xff, 0xff, 0xff, 0xff, 0xff, 0xff, 0xff, 0xff, 0xff, 0xff, 0xff, 0xff, 0xff, 0xff, 0xff,
                                               0xff, 0xff, 0xff, 0xff, 0xff, 0xff, 0xff, 0xff, 0xff, 0xff, 0xff, 0xff, 0xff, 0xff, 0xff, 0xff,
                                               0xff, 0xff, 0xff, 0xff, 0xff, 0xff, 0xff, 0xff, 0xff, 0xff, 0xff, 0xff, 0xff, 0xff, 0xff, 0xff,
                                               0xff, 0xff, 0xff, 0xff, 0xff, 0xff, 0xff, 0xff, 0xff, 0xff, 0xff, 0xff, 0xff, 0xff, 0xff, 0xff,
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                                               0xff, 0xff, 0xff, 0xff, 0xff, 0xff, 0xff, 0xff, 0xff, 0xff, 0xff, 0xff, 0xff, 0xff, 0xff, 0xff};

void setup()
{
    Serial.begin(9600); // Initialize serial communication

    pinMode(buttonPin_L, INPUT_PULLUP);
    pinMode(buttonPin_R, INPUT_PULLUP);

    if (!display.begin(SSD1306_SWITCHCAPVCC, 0x3C))
    { // Address 0x3D for 128x64
        Serial.println(F("SSD1306 allocation failed"));
        for (;;)
            ;
    }
    delay(2000);
    display.clearDisplay();
    display.setTextSize(1.5);
    display.setTextColor(WHITE);
    display.setCursor(0, 10);
    display.println("Hello World!");
    display.display();
    delay(3000);
    display.clearDisplay();
    display.drawBitmap(0, 0, image_data_array, 128, 64, 1);
    display.display();

    // Example of printing the privateKey in hex (similarly for publicKey)
    for (int i = 0; i < sizeof(privateKey); i++)
    {
        if (privateKey[i] < 0x10)
            Serial.print("0");
        Serial.print(privateKey[i], HEX);
    }

    // for(int i=0 ; i< sizeof(publicKey) ; i++) {
    //   Serial.print(publicKey[i], HEX);
    // }
}

int checkButtons()
{
    int buttonState_L = digitalRead(buttonPin_L);
    int buttonState_R = digitalRead(buttonPin_R);

    if (buttonState_L == LOW && buttonState_R == LOW)
    {
        return 1;
    }
    else
    {
        return -1;
    }
}

void generateKeyPair()
{

    display.clearDisplay();
    display.setTextSize(1.5);
    display.setTextColor(WHITE);
    display.setCursor(0, 10);
    display.println("Generating Keypair");
    display.display();

    Ed25519::generatePrivateKey(privateKey);
    Ed25519::derivePublicKey(publicKey, privateKey);

    state = 1;

    delay(500);
}

void signTx()
{
    // Get the length of the transaction message
    int length = transaction.length();

    // Create an array to hold the signature

    // Sign the transaction - assuming transaction is a String object
    // Cast the string to const void* for the message parameter
    Ed25519::sign(sig, privateKey, publicKey, (const uint8_t *)transaction.c_str(), length);

    // Convert signature to a hexadecimal string for display
    for (int i = 0; i < 64; ++i)
    {
        if (sig[i] < 0x10)
        {
            Serial.print("0"); // Print a leading zero if the byte is less than 0x10
        }
        Serial.print(sig[i], HEX);
    }
    Serial.println();
    delay(1000);
    changeToTxConfirmed();
}

void changeToTxConfirmed()
{
    char firstPart[9];
    char lastPart[9];
    sprintf(firstPart, "%02X%02X%02X%02X",
            sig[0], sig[1], sig[2], sig[3]);
    sprintf(lastPart, "%02X%02X%02X%02X",
            sig[28], sig[29], sig[30], sig[31]);

    display.clearDisplay();
    display.setTextSize(1.5);
    display.setTextColor(WHITE);
    display.setCursor(0, 10);
    display.println("Tx is confirmed! \n");
    display.print(firstPart);
    display.print("....");
    display.println(lastPart);
    display.display();

    state = 1;
    delay(500);
}

void changeToHomeScreen()
{

    char firstPart[9];
    char lastPart[9];
    sprintf(firstPart, "%02X%02X%02X%02X",
            publicKey[0], publicKey[1], publicKey[2], publicKey[3]);
    sprintf(lastPart, "%02X%02X%02X%02X",
            publicKey[28], publicKey[29], publicKey[30], publicKey[31]);

    display.clearDisplay();
    display.setTextSize(1.5);
    display.setTextColor(WHITE);
    display.setCursor(0, 10);
    display.println("Home Screen is here! \n");
    display.print(firstPart);
    display.print("....");
    display.println(lastPart);
    display.display();

    state = 2;
    delay(500);
}

void changeToWaitingForTx()
{
    display.clearDisplay();
    display.setTextSize(1.5);
    display.setTextColor(WHITE);
    display.setCursor(0, 10);
    display.println("No TX recieved!");
    display.display();
    state = 1;
}

void changeToConfirmTx(String tx)
{
    display.clearDisplay();
    display.setTextSize(1.5);
    display.setTextColor(WHITE);
    display.setCursor(0, 10);
    display.println("Confirm the tx");
    display.println(tx);
    display.display();
    transaction = tx;
    state = 4;
}

void changeToDefault()
{
    display.clearDisplay();
    display.setTextSize(1.5);
    display.setTextColor(WHITE);
    display.setCursor(0, 10);
    display.println("Please enter a valid input, going to home-screen");
    delay(500);
    changeToHomeScreen();
    display.display();
}

void loop()
{
    int buttonResult = checkButtons();

    if (Serial.available() > 0)
    {
        String receivedLine = Serial.readStringUntil('\n');
        changeToConfirmTx(receivedLine);
        Serial.println(receivedLine);
    }

    switch (buttonResult)
    {
    case 1:
        if (state == 0)
        {
            generateKeyPair();
        }
        if (state == 1)
        {
            changeToHomeScreen();
            break;
        }
        if (state == 2)
        {
            changeToWaitingForTx();
        }
        if (state == 4)
        {
            signTx();
        }
        delay(500);
        break;
    default:
        // Do nothing or handle the case when no button is pressed
        break;
    }
    delay(30);
}